/******************************************************************************
 * Copyright (c) 2026, Lucas Kirschner <kirschnerlucas1@gmail.com>
 *
 * Permission is hereby granted, free of charge, to any person obtaining a copy
 * of this software and associated documentation files (the "Software"), to deal
 * in the Software without restriction, including without limitation the rights
 * to use, copy, modify, merge, publish, distribute, sublicense, and/or sell
 * copies of the Software, and to permit persons to whom the Software is
 * furnished to do so, subject to the following conditions:
 *
 * The above copyright notice and this permission notice shall be included in
 * all copies or substantial portions of the Software.
 *
 * THE SOFTWARE IS PROVIDED "AS IS", WITHOUT WARRANTY OF ANY KIND, EXPRESS OR
 * IMPLIED, INCLUDING BUT NOT LIMITED TO THE WARRANTIES OF MERCHANTABILITY,
 * FITNESS FOR A PARTICULAR PURPOSE AND NONINFRINGEMENT. IN NO EVENT SHALL THE
 * AUTHORS OR COPYRIGHT HOLDERS BE LIABLE FOR ANY CLAIM, DAMAGES OR OTHER
 * LIABILITY, WHETHER IN AN ACTION OF CONTRACT, TORT OR OTHERWISE, ARISING FROM,
 * OUT OF OR IN CONNECTION WITH THE SOFTWARE OR THE USE OR OTHER DEALINGS IN THE
 * SOFTWARE.
 *
 * SPDX-License-Identifier: MIT
 *****************************************************************************/

/**
 * @file    app_user.c
 * @author  Lucas Kirschner <kirschnerlucas1@gmail.com>
 * @date    2026-05-27
 * @brief   User application task implementation.
 *
 * @details
 * This module provides the user application entry point.
 *
 * The file is intentionally organized with USER CODE sections, following a
 * style similar to the one generated by STM32CubeMX. These sections indicate
 * where the final user can add application-specific code without modifying the
 * base firmware layers.
 *
 * This implementation provides a minimal radio transmission test intended for
 * a node configured as an IEEE 802.15.4 device.
 *
 * The device periodically sends a one-byte incremental value to the PAN
 * coordinator at short address 0x0000.
 *
 * app_radio_send() only reports whether the message was successfully queued.
 * The definitive transmission result is obtained asynchronously by the radio
 * application task after the MRF24J40 reports TX completion.
 *
 * The radio application therefore reports through the debug console:
 *
 * - successful transmission
 * - number of hardware retransmissions
 * - missing acknowledgment after retry exhaustion
 * - CSMA-CA channel access failure
 *
 * ACK monitoring and retransmission are entirely handled by the MRF24J40
 * hardware.
 *
 * @ingroup app_user
 * @{
 */

/* Includes ------------------------------------------------------------------*/
#include "cmsis_os2.h"

#include <stdint.h>
#include <stdio.h>

/* Private includes ----------------------------------------------------------*/
/* USER CODE BEGIN Includes */

#include "app_user.h"
#include "app_radio.h"
#include "app_din.h"
#include "app_dout.h"
#include "app_rs485.h"

#include "swo.h"

/* USER CODE END Includes */

/* Private typedef -----------------------------------------------------------*/
/* USER CODE BEGIN PTD */

/* USER CODE END PTD */

/* Private define ------------------------------------------------------------*/
/* USER CODE BEGIN PD */

/**
 * @brief Period, in milliseconds, between radio transmissions.
 */
#define APP_USER_UPDATE_PERIOD_MS        ((uint32_t)1000u)

/**
 * @brief PAN coordinator destination short address.
 */
#define APP_USER_RADIO_DESTINATION       APP_RADIO_COORDINATOR_ADDRESS

/* USER CODE END PD */

/* Private macro -------------------------------------------------------------*/
/* USER CODE BEGIN PM */

/* USER CODE END PM */

/* Private variables ---------------------------------------------------------*/
/* USER CODE BEGIN PV */

/**
 * @brief Incremental application byte transmitted to the PAN coordinator.
 *
 * @details
 * The value naturally wraps from 0xFF to 0x00.
 */
static uint8_t app_user_tx_data = 0u;

/* USER CODE END PV */

/* Private function prototypes -----------------------------------------------*/
/* USER CODE BEGIN PFP */

/* USER CODE END PFP */

/* Private user code ---------------------------------------------------------*/
/* USER CODE BEGIN 0 */

/* USER CODE END 0 */

/**
 * @brief User application task.
 *
 * @param argument Task argument. Not used.
 *
 * @details
 * This task implements a minimal periodic radio transmission test.
 *
 * Code inside USER CODE BEGIN app_init is executed once before the periodic
 * loop starts.
 *
 * Code inside USER CODE BEGIN app_task sends one incremental byte to the PAN
 * coordinator every APP_USER_UPDATE_PERIOD_MS milliseconds.
 *
 * app_radio_send() is asynchronous. APP_RADIO_OK indicates only that the
 * message entered the radio TX queue successfully.
 *
 * The definitive transmission result, including acknowledgment and hardware
 * retry information, is reported asynchronously by app_radio_task().
 */
void app_user_task(void * argument)
{
    (void)argument;

    /* USER CODE BEGIN app_init */

    printf("\r\n");
    printf("[APP_USER] Radio device transmission test\r\n");
    printf("[APP_USER] Destination: 0x%04X\r\n",
           APP_USER_RADIO_DESTINATION);
    printf("[APP_USER] Period: %lu ms\r\n",
           (unsigned long)APP_USER_UPDATE_PERIOD_MS);

    /* USER CODE END app_init */

    for (;;)
    {
        /* USER CODE BEGIN app_task */

        app_radio_status_t radio_status;

        /*
         * Enqueue one byte for confirmed IEEE 802.15.4 transmission.
         *
         * app_radio automatically requests an ACK and the MRF24J40 performs
         * the complete ACK timeout and retransmission procedure in hardware.
         */
        radio_status =
            app_radio_send(APP_USER_RADIO_DESTINATION,
                           app_user_tx_data);

        if (radio_status == APP_RADIO_OK)
        {
            printf("[APP_USER] TX request dst=0x%04X data=0x%02X (%u)\r\n",
                   APP_USER_RADIO_DESTINATION,
                   app_user_tx_data,
                   app_user_tx_data);

            /*
             * Increment only after the message was accepted by the TX queue.
             * uint8_t overflow intentionally produces 0xFF -> 0x00 wraparound.
             */
            app_user_tx_data++;
        }
        else if (radio_status == APP_RADIO_E_QUEUE_FULL)
        {
            printf("[APP_USER] TX queue full data=0x%02X\r\n",
                   app_user_tx_data);
        }
        else
        {
            printf("[APP_USER] TX request error=%d data=0x%02X\r\n",
                   (int)radio_status,
                   app_user_tx_data);
        }

        /*
         * The final result is intentionally not checked from this task.
         *
         * app_radio_task() owns the MRF24J40 and prints:
         *
         *   [APP_RADIO] TX success retries=N
         *
         * or:
         *
         *   [APP_RADIO] TX failed: no ACK retries=N
         *
         * or:
         *
         *   [APP_RADIO] TX failed: CCA retries=N
         *
         * This preserves the radio driver ownership model and prevents direct
         * access to the MRF24J40 from the user application task.
         */

        /* USER CODE END app_task */

        osDelay(APP_USER_UPDATE_PERIOD_MS);
    }
}

/* USER CODE BEGIN 1 */

/* USER CODE END 1 */

/** @} */
