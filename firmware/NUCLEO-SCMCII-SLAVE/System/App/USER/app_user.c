/******************************************************************************
 * Copyright (c) 2026, Lucas Kirschner <kirschnerlucas1@gmail.com>
 *
 * Permission is hereby granted, free of charge, to any person obtaining a copy
 * of this software and associated documentation files (the "Software"), to deal
 * in the Software without restriction, including without limitation the rights
 * to use, copy, modify, merge, publish, distribute, sublicense, and/or sell
 * copies of the Software, and to permit persons to whom the Software is
 * furnished to do so, subject to the following conditions:
 *
 * The above copyright notice and this permission notice shall be included in
 * all copies or substantial portions of the Software.
 *
 * THE SOFTWARE IS PROVIDED "AS IS", WITHOUT WARRANTY OF ANY KIND, EXPRESS OR
 * IMPLIED, INCLUDING BUT NOT LIMITED TO THE WARRANTIES OF MERCHANTABILITY,
 * FITNESS FOR A PARTICULAR PURPOSE AND NONINFRINGEMENT. IN NO EVENT SHALL THE
 * AUTHORS OR COPYRIGHT HOLDERS BE LIABLE FOR ANY CLAIM, DAMAGES OR OTHER
 * LIABILITY, WHETHER IN AN ACTION OF CONTRACT, TORT OR OTHERWISE, ARISING FROM,
 * OUT OF OR IN CONNECTION WITH THE SOFTWARE OR THE USE OR OTHER DEALINGS IN THE
 * SOFTWARE.
 *
 * SPDX-License-Identifier: MIT
 ******************************************************************************/

/**
 * @file    app_user.c
 * @author  Lucas Kirschner <kirschnerlucas1@gmail.com>
 * @date    2026-05-27
 * @brief   User application task implementation.
 *
 * @details
 * This module provides the user application entry point.
 *
 * The file is intentionally organized with USER CODE sections, following a
 * style similar to the one generated by STM32CubeMX. These sections indicate
 * where the final user can add application-specific code without modifying the
 * base firmware layers.
 *
 * This implementation provides simple validation tests for the main application
 * services.
 *
 * The available tests are:
 *
 * - Periodic IEEE 802.15.4 radio transmission.
 * - Digital input/output mirror.
 * - Single-byte RS485 echo.
 *
 * Only one test is intended to be enabled at a time.
 *
 * The RS485 echo test operates entirely through the app_rs485 public API.
 *
 * Each byte received through RS485 is retrieved from the application receive
 * queue and immediately requested for retransmission through the application
 * transmit queue.
 *
 * The app_rs485 task remains the exclusive owner of the lower RS485 driver and
 * manages reception, half-duplex direction switching and asynchronous UART
 * transmission.
 *
 * @ingroup app_user
 * @{
 */

/* Includes ------------------------------------------------------------------*/

#include "cmsis_os2.h"

#include <stdint.h>
#include <stdio.h>

/* Private includes ----------------------------------------------------------*/

/* USER CODE BEGIN Includes */

#include "app_user.h"
#include "app_radio.h"
#include "app_din.h"
#include "app_dout.h"
#include "app_rs485.h"
#include "swo.h"

/* USER CODE END Includes */

/* Private typedef -----------------------------------------------------------*/

/* USER CODE BEGIN PTD */

/* USER CODE END PTD */

/* Private define ------------------------------------------------------------*/

/* USER CODE BEGIN PD */

/**
 * @brief Enable radio communication test.
 */
#define APP_USER_TEST_RADIO

/**
 * @brief Enable digital input/output mirror test.
 */
/* #define APP_USER_TEST_IO_MIRROR */

/**
 * @brief Enable single-byte RS485 echo test.
 */
/* #define APP_USER_TEST_RS485_ECHO */

/**
 * @brief Enable digital-output timing test.
 */
/* #define APP_USER_TEST_DOUT_TIMING */

/**
 * @brief Number of digital-output requests generated by the timing test.
 */
#define APP_USER_DOUT_TIMING_SAMPLES        ((uint32_t)1000u)

/**
 * @brief Delay before retrying when the digital-output queue is full.
 */
#define APP_USER_DOUT_RETRY_DELAY_MS        ((uint32_t)1u)

/**
 * @brief Period, in milliseconds, between radio transmissions.
 */
#define APP_USER_UPDATE_PERIOD_MS          ((uint32_t)1000u)

/**
 * @brief Period, in milliseconds, between digital I/O updates.
 */
#define APP_USER_IO_UPDATE_PERIOD_MS       ((uint32_t)10u)

/**
 * @brief Delay, in milliseconds, between RS485 receive queue checks.
 *
 * @details
 * app_rs485_receive() is non-blocking. A short delay prevents the user task
 * from continuously polling the receive queue while keeping the echo response
 * latency low.
 */
#define APP_USER_RS485_UPDATE_PERIOD_MS    ((uint32_t)1u)

/**
 * @brief PAN coordinator destination short address.
 */
#define APP_USER_RADIO_DESTINATION         APP_RADIO_COORDINATOR_ADDRESS

/* USER CODE END PD */

/* Private macro -------------------------------------------------------------*/

/* USER CODE BEGIN PM */

/* USER CODE END PM */

/* Private variables ---------------------------------------------------------*/

/* USER CODE BEGIN PV */

/**
 * @brief Incremental application byte transmitted to the PAN coordinator.
 *
 * @details
 * The value naturally wraps from 0xFF to 0x00.
 */
static uint8_t app_user_tx_data = 0u;

/* USER CODE END PV */

/* Private function prototypes -----------------------------------------------*/

/* USER CODE BEGIN PFP */

static void app_user_radio_test(void);

static void app_user_io_mirror_test(void);

static void app_user_rs485_echo_test(void);

static void app_user_dout_timing_test(void);

/* USER CODE END PFP */

/* Private user code ---------------------------------------------------------*/

/* USER CODE BEGIN 0 */

static void app_user_radio_test(void)
{
    printf("\r\n");

    printf("[APP_USER] Radio device transmission test\r\n");

    printf("[APP_USER] Destination: 0x%04X\r\n",
           APP_USER_RADIO_DESTINATION);

    printf("[APP_USER] Period: %lu ms\r\n",
           (unsigned long)APP_USER_UPDATE_PERIOD_MS);

    for (;;)
    {
        app_radio_status_t radio_status;

        /*
         * Enqueue one byte for confirmed IEEE 802.15.4 transmission.
         *
         * app_radio automatically requests an ACK and the MRF24J40 performs
         * the complete ACK timeout and retransmission procedure in hardware.
         */
        radio_status =
            app_radio_send(
                APP_USER_RADIO_DESTINATION,
                app_user_tx_data);

        if (radio_status == APP_RADIO_OK)
        {
            printf(
                "[APP_USER] TX request dst=0x%04X data=0x%02X (%u)\r\n",
                APP_USER_RADIO_DESTINATION,
                app_user_tx_data,
                app_user_tx_data);

            /*
             * Increment only after the message was accepted by the TX queue.
             * uint8_t overflow intentionally produces 0xFF -> 0x00 wraparound.
             */
            app_user_tx_data++;
        }
        else if (radio_status == APP_RADIO_E_QUEUE_FULL)
        {
            printf(
                "[APP_USER] TX queue full data=0x%02X\r\n",
                app_user_tx_data);
        }
        else
        {
            printf(
                "[APP_USER] TX request error=%d data=0x%02X\r\n",
                (int)radio_status,
                app_user_tx_data);
        }

        /*
         * The final result is intentionally not checked from this task.
         *
         * app_radio_task() owns the MRF24J40 and prints:
         *
         *   [APP_RADIO] TX success retries=N
         *
         * or:
         *
         *   [APP_RADIO] TX failed: no ACK retries=N
         *
         * or:
         *
         *   [APP_RADIO] TX failed: CCA retries=N
         *
         * This preserves the radio driver ownership model and prevents direct
         * access to the MRF24J40 from the user application task.
         */
        osDelay(APP_USER_UPDATE_PERIOD_MS);
    }
}

static void app_user_io_mirror_test(void)
{
    printf("\r\n");

    printf("[APP_USER] Digital input/output mirror test\r\n");

    printf("[APP_USER] DIN0..DIN7 -> DOUT0..DOUT7\r\n");

    printf("[APP_USER] Period: %lu ms\r\n",
           (unsigned long)APP_USER_IO_UPDATE_PERIOD_MS);

    for (;;)
    {
        uint8_t input_image;

        app_din_status_t din_status;

        app_dout_status_t dout_status;

        /*
         * Read the latest digital input image using the non-blocking app_din
         * public API.
         */
        din_status =
            app_din_read(
                &input_image);

        if (din_status == APP_DIN_OK)
        {
            /*
             * Mirror each digital input directly to the corresponding output:
             *
             * DIN0 -> DOUT0
             * DIN1 -> DOUT1
             * ...
             * DIN7 -> DOUT7
             */
            dout_status =
                app_dout_set_outputs(
                    input_image);

            if (dout_status != APP_DOUT_OK)
            {
                printf(
                    "[APP_USER] app_dout_set_outputs() failed: %d\r\n",
                    (int)dout_status);
            }
        }
        else if (din_status == APP_DIN_E_NOT_READY)
        {
            /*
             * No valid input image has been acquired yet.
             */
        }
        else if (din_status == APP_DIN_E_BUSY)
        {
            /*
             * Input image mutex is temporarily unavailable.
             */
        }
        else if (din_status != APP_DIN_E_NULL)
        {
            printf(
                "[APP_USER] app_din_read() failed: %d\r\n",
                (int)din_status);
        }
        else
        {
            /*
             * Null pointer is not expected here.
             */
        }

        osDelay(APP_USER_IO_UPDATE_PERIOD_MS);
    }
}

/**
 * @brief Run the single-byte RS485 echo test.
 *
 * @details
 * This test reproduces at application level the behavior of the original
 * standalone RS485 validation program.
 *
 * The RS485 application service continuously receives bytes in the background
 * and places them into its input queue.
 *
 * This function retrieves each available byte and requests transmission of the
 * same value through app_rs485_send().
 *
 * The resulting communication sequence is:
 *
 * @code
 * RS485 RX
 *    |
 *    v
 * app_rs485_task()
 *    |
 *    v
 * RS485 input queue
 *    |
 *    v
 * app_rs485_receive()
 *    |
 *    v
 * app_rs485_send()
 *    |
 *    v
 * RS485 output queue
 *    |
 *    v
 * app_rs485_task()
 *    |
 *    v
 * RS485 TX
 * @endcode
 *
 * No direct access to the RS485 driver or UART peripheral is performed from
 * this task.
 */
static void app_user_rs485_echo_test(void)
{
    printf("\r\n");

    printf("[APP_USER] RS485 single-byte echo test\r\n");

    printf("[APP_USER] RX byte -> TX same byte\r\n");

    printf("[APP_USER] Poll period: %lu ms\r\n",
           (unsigned long)APP_USER_RS485_UPDATE_PERIOD_MS);

    for (;;)
    {
        uint8_t rx_data = 0u;

        app_rs485_status_t rx_status;

        /*
         * Retrieve one byte from the RS485 application receive queue.
         *
         * The operation is non-blocking. APP_RS485_E_QUEUE_EMPTY is expected
         * while no new byte is available.
         */
        rx_status =
            app_rs485_receive(
                &rx_data);

        if (rx_status == APP_RS485_OK)
        {
            app_rs485_status_t tx_status;

            printf(
                "[APP_USER] RS485 RX: 0x%02X '%c'\r\n",
                rx_data,
                ((rx_data >= 0x20u) &&
                 (rx_data <= 0x7Eu)) ?
                    (char)rx_data :
                    '.');

            /*
             * Echo the received byte through the asynchronous RS485
             * application service.
             *
             * APP_RS485_OK indicates that the byte was accepted by the
             * transmission queue. The physical UART transmission is performed
             * asynchronously by app_rs485_task().
             */
            tx_status =
                app_rs485_send(
                    rx_data);

            if (tx_status == APP_RS485_OK)
            {
                printf(
                    "[APP_USER] RS485 echo TX request: 0x%02X '%c'\r\n",
                    rx_data,
                    ((rx_data >= 0x20u) &&
                     (rx_data <= 0x7Eu)) ?
                        (char)rx_data :
                        '.');
            }
            else if (tx_status == APP_RS485_E_QUEUE_FULL)
            {
                printf(
                    "[APP_USER] RS485 TX queue full: 0x%02X\r\n",
                    rx_data);
            }
            else if (tx_status == APP_RS485_E_STATE)
            {
                printf(
                    "[APP_USER] app_rs485_send() not ready\r\n");
            }
            else
            {
                printf(
                    "[APP_USER] app_rs485_send() failed: %d\r\n",
                    (int)tx_status);
            }
        }
        else if (rx_status == APP_RS485_E_QUEUE_EMPTY)
        {
            /*
             * No received byte is currently available.
             *
             * This is the normal idle condition and is intentionally not
             * reported through the debug console.
             */
        }
        else if (rx_status == APP_RS485_E_STATE)
        {
            /*
             * The RS485 service may still be completing its initialization.
             *
             * Keep waiting without treating this transient condition as an
             * application error.
             */
        }
        else if (rx_status != APP_RS485_E_NULL)
        {
            printf(
                "[APP_USER] app_rs485_receive() failed: %d\r\n",
                (int)rx_status);
        }
        else
        {
            /*
             * Null pointer is not expected here.
             */
        }

        osDelay(APP_USER_RS485_UPDATE_PERIOD_MS);
    }
}

/**
 * @brief Generate output requests for the digital-output timing test.
 *
 * @details
 * This test sends APP_USER_DOUT_TIMING_SAMPLES output images through the
 * app_dout public API, alternating between 0x00 and 0xFF.
 *
 * If the output queue is full, the current sample is retained and retried
 * after a short delay. Therefore, exactly APP_USER_DOUT_TIMING_SAMPLES
 * requests are successfully dispatched.
 *
 * The function does not access the VNI8200XP-32 driver directly. Execution
 * time measurements are performed by app_dout_task() when each queued output
 * image is processed.
 */
static void app_user_dout_timing_test(void)
{
    uint32_t sample = 0u;
    uint8_t output_image;
    app_dout_status_t status;

    printf("\r\n");
    printf("[APP_USER] DOUT timing test\r\n");

    while (sample < APP_USER_DOUT_TIMING_SAMPLES)
    {
        if ((sample & 1u) == 0u)
        {
            output_image = 0x00u;
        }
        else
        {
            output_image = 0xFFu;
        }

        status = app_dout_set_outputs(output_image);

        if (status == APP_DOUT_OK)
        {
            sample++;
        }
        else if (status == APP_DOUT_E_QUEUE_FULL)
        {
            /*
             * Keep the current sample and retry it after allowing
             * app_dout_task() to consume pending queue entries.
             */
            osDelay(APP_USER_DOUT_RETRY_DELAY_MS);
        }
        else
        {
            printf("[APP_USER] DOUT request error: %d\r\n",
                   (int)status);

            osDelay(APP_USER_DOUT_RETRY_DELAY_MS);
        }
    }

    printf("[APP_USER] DOUT requests completed: %lu\r\n",
           (unsigned long)sample);

    for (;;)
    {
        osDelay(osWaitForever);
    }
}

/* USER CODE END 0 */

/**
 * @brief User application task.
 *
 * @param argument Task argument. Not used.
 *
 * @details
 * This task provides the application-level validation tests.
 *
 * Only one APP_USER_TEST_* option is intended to be enabled at a time.
 *
 * The radio test periodically queues one incremental byte for transmission to
 * the PAN coordinator.
 *
 * The digital I/O mirror test copies DIN0..DIN7 directly to DOUT0..DOUT7.
 *
 * The RS485 echo test retrieves each byte received by app_rs485_task() and
 * requests asynchronous retransmission of the same byte through app_rs485_send().
 *
 * The communication and peripheral service tasks retain ownership of their
 * corresponding low-level drivers.
 */
void app_user_task(void * argument)
{
    (void)argument;

    /* USER CODE BEGIN app_init */

    printf("[APP_USER] App INIT \r\n");

    /* USER CODE END app_init */

    for (;;)
    {
        /* USER CODE BEGIN app_task */

#if defined(APP_USER_TEST_RADIO)

        app_user_radio_test();

#elif defined(APP_USER_TEST_IO_MIRROR)

        app_user_io_mirror_test();

#elif defined(APP_USER_TEST_RS485_ECHO)

        app_user_rs485_echo_test();

#elif defined(APP_USER_TEST_DOUT_TIMING)

        app_user_dout_timing_test();

#endif

        /* USER CODE END app_task */

        osDelay(APP_USER_UPDATE_PERIOD_MS);
    }
}

/* USER CODE BEGIN 1 */

/* USER CODE END 1 */

/** @} */
